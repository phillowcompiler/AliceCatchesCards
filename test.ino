#include <Arduboy2.h>

PROGMEM const unsigned char sprptn_card[] =
{
11,16,
// back
//0x0F, 0xF7, 0x5B, 0xAB, 0x5B, 0xAB, 0x5B, 0xAB, 0x5B, 0xF7, 
//0x0F, 0xF0, 0xEF, 0xD5, 0xDA, 0xD5, 0xDA, 0xD5, 0xDA, 0xD5, 
//0xEF, 0xF0,
// joker
0x0F, 0xF7, 0x9B, 0xBB, 0x8B, 0xFB, 0x8B, 0xAB, 0x8B, 0xF7, 
0x0F, 0xF0, 0xEF, 0xD3, 0xD0, 0xD5, 0xD1, 0xD5, 0xD0, 0xD3, 
0xEF, 0xF0,
// heart
0x00, 0xF0, 0x38, 0x18, 0x38, 0x78, 0x38, 0x18, 0x38, 0xF0, 
0x00, 0x00, 0x0F, 0x1E, 0x1C, 0x18, 0x10, 0x18, 0x1C, 0x1E, 
0x0F, 0x00,
// spade  
0x00, 0xF0, 0x78, 0x38, 0x18, 0x08, 0x18, 0x38, 0x78, 0xF0, 
0x00, 0x00, 0x0F, 0x1E, 0x14, 0x14, 0x10, 0x14, 0x14, 0x1E, 
0x0F, 0x00,
//dya
0x00, 0xF0, 0x78, 0x38, 0x18, 0x08, 0x18, 0x38, 0x78, 0xF0, 
0x00, 0x00, 0x0F, 0x1E, 0x1C, 0x18, 0x10, 0x18, 0x1C, 0x1E, 
0x0F, 0x00,
//clab
0x00, 0xF0, 0x78, 0x78, 0x98, 0x08, 0x98, 0x78, 0x78, 0xF0, 
0x00, 0x00, 0x0F, 0x1C, 0x1C, 0x16, 0x10, 0x16, 0x1C, 0x1C, 
0x0F, 0x00,
// fire01
0xFC, 0xFC, 0x5C, 0xBC, 0x54, 0x2C, 0x94, 0x2C, 0x7C, 0xFC, 
0xFC, 0x3F, 0x38, 0x33, 0x28, 0x21, 0x24, 0x21, 0x32, 0x38, 
0x3F, 0x3F,
// fire02
0xFC, 0x7C, 0x2C, 0x94, 0x2C, 0x54, 0xBC, 0x5C, 0xFC, 0xFC, 
0xFC, 0x3F, 0x38, 0x32, 0x21, 0x24, 0x21, 0x28, 0x33, 0x38, 
0x3F, 0x3F,

};

PROGMEM const unsigned char sprptn_alice[] =
{
16, 16,
// R1
0x00, 0x00, 0x00, 0xF8, 0xF8, 0x3C, 0xFC, 0x04, 0xEC, 0xEC, 
0x89, 0xE9, 0x09, 0x00, 0x00, 0x00, 0x00, 0x00, 0x01, 0x01, 
0x00, 0x41, 0x09, 0x84, 0x91, 0x9D, 0x19, 0x41, 0x02, 0x00, 
0x00, 0x00,
// R2
0x00, 0x00, 0x00, 0xF8, 0xF8, 0x3C, 0xFC, 0x04, 0xEC, 0xEC, 
0x88, 0xE9, 0x08, 0x00, 0x00, 0x00, 0x00, 0x00, 0x00, 0x00, 
0x01, 0x00, 0x01, 0x4D, 0x80, 0x5D, 0x19, 0x01, 0x00, 0x00, 
0x00, 0x00,
// L1
0x00, 0x00, 0x00, 0x09, 0xE9, 0x89, 0xEC, 0xEC, 0x04, 0xFC, 
0x3C, 0xF8, 0xF8, 0x00, 0x00, 0x00, 0x00, 0x00, 0x00, 0x02, 
0x41, 0x19, 0x9D, 0x91, 0x84, 0x09, 0x41, 0x00, 0x01, 0x01, 
0x00, 0x00,
// L2
0x00, 0x00, 0x00, 0x08, 0xE9, 0x88, 0xEC, 0xEC, 0x04, 0xFC, 
0x3C, 0xF8, 0xF8, 0x00, 0x00, 0x00, 0x00, 0x00, 0x00, 0x00, 
0x01, 0x19, 0x5D, 0x80, 0x4D, 0x01, 0x00, 0x01, 0x00, 0x00, 
0x00, 0x00,
// Stop
0x00, 0x00, 0xF0, 0xD8, 0x0C, 0xEC, 0x88, 0xE9, 0xE9, 0x88, 
0xEC, 0x0C, 0xD8, 0xF0, 0x00, 0x00, 0x00, 0x00, 0x00, 0x05, 
0x41, 0x18, 0xBD, 0xB9, 0xB9, 0xBD, 0x18, 0x41, 0x05, 0x00, 
0x00, 0x00,
};

PROGMEM const unsigned char sprptn_alicemask[] =
{
//R1
0x00, 0x00, 0xF8, 0xFC, 0xFC, 0xFE, 0xFE, 0xFE, 0xFF, 0xFF, 
0xFF, 0xFF, 0xFF, 0x1B, 0x00, 0x00, 0x00, 0x03, 0x03, 0x63, 
0x73, 0xFF, 0xFF, 0x7F, 0x7F, 0x7F, 0xFF, 0xFF, 0x67, 0x02, 
0x00, 0x00,
//R2
0x00, 0x00, 0xF8, 0xFC, 0xFC, 0xFE, 0xFE, 0xFE, 0xFF, 0xFF, 
0xFF, 0xFF, 0xFF, 0x1B, 0x00, 0x00, 0x00, 0x00, 0x20, 0x61, 
0x73, 0x7F, 0xFF, 0xFF, 0x7F, 0xFF, 0xFF, 0x7F, 0x61, 0x40, 
0x00, 0x00,
//L1
0x00, 0x00, 0x1B, 0xFF, 0xFF, 0xFF, 0xFF, 0xFF, 0xFE, 0xFE, 
0xFE, 0xFC, 0xFC, 0xF8, 0x00, 0x00, 0x00, 0x00, 0x02, 0x67, 
0xFF, 0xFF, 0x7F, 0x7F, 0x7F, 0xFF, 0xFF, 0x73, 0x63, 0x03, 
0x03, 0x00,
//L2
0x00, 0x00, 0x1B, 0xFF, 0xFF, 0xFF, 0xFF, 0xFF, 0xFE, 0xFE, 
0xFE, 0xFC, 0xFC, 0xF8, 0x00, 0x00, 0x00, 0x00, 0x40, 0x61, 
0x7F, 0xFF, 0xFF, 0xFF, 0xFF, 0xFF, 0x7F, 0x73, 0x61, 0x20, 
0x00, 0x00,
//Stop
0x00, 0xF0, 0xF8, 0xFC, 0xFF, 0xFF, 0xFF, 0xFF, 0xFF, 0xFF, 
0xFF, 0xFF, 0xFC, 0xF8, 0xF0, 0x00, 0x00, 0x00, 0x65, 0x7F, 
0xFF, 0xFF, 0xFF, 0xFF, 0xFF, 0xFF, 0xFF, 0xFF, 0x7F, 0x65, 
0x00, 0x00,
};


PROGMEM const unsigned char sprptn_face[] = {
// width, height
10, 10,
// smile
0x01, 0xF6, 0xDA, 0xB6, 0xBE, 0xB6, 0xDA, 0xF6, 0x01, 0xFF, 
0x03, 0x02, 0x02, 0x02, 0x02, 0x02, 0x02, 0x02, 0x03, 0x03,
// bad
0x01, 0xFE, 0xB2, 0xDE, 0xDE, 0xDE, 0xB2, 0xFE, 0x01, 0xFF, 
0x03, 0x02, 0x02, 0x02, 0x02, 0x02, 0x02, 0x02, 0x03, 0x03,
};

PROGMEM const unsigned char sprptn_facemask[] = {
0xFF, 0xFF, 0xFF, 0xFF, 0xFF, 0xFF, 0xFF, 0xFF, 0xFF, 0xFF, 
0x03, 0x03, 0x03, 0x03, 0x03, 0x03, 0x03, 0x03, 0x03, 0x03,
};

PROGMEM const unsigned char sprptn_back[] = {
// width, height
20, 8,
0xFF, 0xFF, 0xFF, 0xFB, 0x15, 0xFB, 0xFF, 0xFF, 0xFF, 0xFF, 
0xFF, 0xFF, 0xFF, 0xBF, 0x51, 0xBF, 0xFF, 0xFF, 0xFF, 0xFF
};


PROGMEM const unsigned char sprptn_block[] = {
// width, height
8, 8,
0xBB, 0xEE, 0xBB, 0xFF, 0xBB, 0xEE, 0xBB, 0xFF
};

PROGMEM const unsigned char sprptn_cardmask[] =
{
0xF0, 0xF8, 0xFC, 0xFC, 0xFC, 0xFC, 0xFC, 0xFC, 0xFC, 0xF8, 
0xF0, 0x0F, 0x1F, 0x3F, 0x3F, 0x3F, 0x3F, 0x3F, 0x3F, 0x3F, 
0x1F, 0x0F
};

PROGMEM const unsigned char sprptn_title[] = {
// width, height
128, 32,
0x00, 0x00, 0x00, 0x00, 0x00, 0x00, 0x00, 0x00, 0x00, 0x00, 
0x00, 0x80, 0x60, 0xF8, 0xE0, 0x00, 0x00, 0x00, 0x00, 0xE8, 
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0x00, 0x00
};

#define CARD_N  6
#define CARDBURN_Y  42

typedef struct{
  uint16_t score;
  int8_t life;
  int8_t status;  //0 Normal, 1 Miss, 2 effect
  uint8_t target;
  uint8_t current;
}st_game;

typedef struct{
  int8_t x;
  uint8_t dir;
  int8_t wait;
  int8_t turn;
  uint8_t frame;
  uint8_t nodmg;
  uint8_t button;
}st_player;

typedef struct{
  uint8_t kind;
  int y;
}st_card;

typedef struct{
  int8_t rslt;
  int8_t x;
  int8_t y;
  int8_t dy;
}st_effect;

Arduboy2 arduboy;
st_game   gl_game;
st_player gl_player;
st_card   gl_card[8];
st_effect gl_effect;


void init_gl_game(){
  gl_game.status = 0;
  gl_game.current = 0;
}

void init_gl_player(){
  gl_player.x = -2;
  gl_player.wait = 0;
  gl_player.turn = 0;
  gl_player.dir = 0;
  //gl_player.frame = 0;
  //gl_player.nodmg = 0;
}

void set_target(){
  gl_game.target = random(5);
  gl_player.turn = 3;
  Sprites::drawExternalMask(102, 8,
    sprptn_card, sprptn_cardmask, gl_game.target, 0);
}

void move_player(){
  if(gl_player.wait){
    if(--gl_player.wait < 1 && !gl_player.turn){set_target();}
    return;
  }
  
  switch(gl_player.dir)
  {
    case 0:
      gl_player.x += 2;
      if(gl_player.x > 96-16){gl_player.x = -2;}
      break;
    case 1:
      gl_player.x -= 2;
      if(gl_player.x < -2){gl_player.x = 80;}
      break;
  }
}

void genCardEffect(uint8_t n){
  gl_effect.x = n * 10 + 9;
  gl_effect.y = gl_card[n].y + 2;
  gl_game.status = 2; //effect
}

void chkcatch(uint8_t n){
  int8_t rslt = 0;
  if(gl_card[n].kind){
    // gl_game.target == 0 is joker.
    if(gl_game.target == 0 || gl_card[n].kind == gl_game.target){
      // catch heart
      int b = gl_player.turn + 1;
      if(gl_card[n].y < 10){gl_game.score += 8 * b;}
      else if(gl_card[n].y < 30){gl_game.score += 3 * b;}
      else{gl_game.score += 1 * b;}
      drawScore();
      gl_effect.rslt = 0;
    }else{
      // miss
      gl_effect.rslt = 1;
    }
    genCardEffect(n);
    gl_card[n].kind = 0;
    set_target();
  }
}

void senceButtonA(){
  if(arduboy.notPressed(A_BUTTON)){
    gl_player.button = 0;
    return;
  }
  if(gl_player.button){return;}
  
  int n = gl_player.x/10;
  // Catch
  if(gl_player.wait){
    chkcatch(n);
  }else{
  // turn
    gl_player.dir ^= 1;
    gl_player.wait = 4;
    if(gl_player.x < 4){gl_player.x = 0;}
    else{
      if(n > 7){gl_player.x = 80;}
      else{gl_player.x = n * 10 + 6;}
    }
    if(gl_player.turn){--gl_player.turn;}
  }
  gl_player.button = 1;
}

void init_gl_card() {
  for(int i = 0; i < 8; i++){
    gl_card[i].kind = 0;
    if(i & 1){
      gl_card[i].kind = i/2 + 1;
      gl_card[i].y = -2;
    }
  }
}

void chkCollisonCard(int c){
  if(gl_player.nodmg){return;}
  int cx = c * 10 + 8;
  int dx = gl_player.x - cx;
  if(dx > -5 && dx < 1){gl_game.status = 1;}  // Miss!
}

void move_card() {
  int c = gl_game.current;
  if(++gl_game.current > 7){gl_game.current = 0;}
  if( gl_card[c].kind ){
    gl_card[c].y += 2;
    if(gl_card[c].y > 56){gl_card[c].kind = 0; return;}
    if(gl_card[c].y >= CARDBURN_Y){
      gl_card[c].kind = 5 + ((gl_card[c].y>>1) & 1);
      chkCollisonCard(c);
    }
  }else{
    // Generated Card
    int n = 0;
    for(int i = 0; i < 8; i++){if(gl_card[i].kind){n++;}}
    if(n > 6){return;}
    if(random(10 + n*2) < 2){
      gl_card[c].kind = random(1,5);
      gl_card[c].y = -2;
    }  
  }
}

void drawScore(){
  uint16_t sc = gl_game.score;
  uint16_t n, m = 10000;
  for(int i = 0; i < 6; i++){
    arduboy.setCursor(98 + i*6, 38);
    n = sc / m;
    arduboy.print(n);
    sc -= n * m;
    m /= 10;
  }
}

void drawLife(){
  arduboy.fillRect(98, 48, 30, 16, WHITE);
  for(int i = 0; i < gl_game.life; i++){
    //Sprites::drawOverwrite(98+i*8, 48, sprptn_alice, 4);
    Sprites::drawExternalMask(98+i*8, 48,
      sprptn_alice, sprptn_alicemask, 4, 4);
  } 
}

void drawTurn(){
  arduboy.fillRect(119, 8, 8, 16, BLACK);
  for(int i = 0; i < 3; i++){
    if(i < gl_player.turn){
      arduboy.fillRect(119, (2-i)*6 + 8, 8, 4, WHITE);  
    }
  }
}

void initGame(){
  // initialize things here
  arduboy.clear();
  arduboy.fillRect(0, 0, 128, 64, WHITE);
  arduboy.fillRect(96, 0, 32, 64, BLACK);
  arduboy.fillRect(100, 8, 15, 16, WHITE);
  
  arduboy.setCursor(98,0);
  arduboy.print("CATCH");
  
  arduboy.setCursor(98,30);
  arduboy.print("SCORE");
  drawScore();
  
  init_gl_game();
  init_gl_player();
  init_gl_card();
  set_target();
  drawTurn();
  drawLife();
}

void drawMiss(){
  arduboy.fillRect(2, 24, 92, 16, BLACK);
  
  arduboy.setCursor(32,28);
  arduboy.print("MISS!");
  arduboy.display();
  delay(1000);
  
  if(--gl_game.life < 1){
    arduboy.setCursor(21,28);
    arduboy.print("GAME OVER");
    arduboy.display();
    delay(3000);
    while(arduboy.notPressed(A_BUTTON)){delay(50);}
    // Reset Game
    gl_game.score = 0;
    gl_game.life = 3;
  }
  initGame();
}

void drawBack(){
  int i,j;
  for(j = 0; j < 6; j++){
  for(i = 0; i < 4; i++){
    Sprites::drawOverwrite(i*20+9, j*8, sprptn_back, 0);  
  }}
  for(i = 0; i < 12; i++){Sprites::drawOverwrite(i*8, 48, sprptn_block, 0);}
  for(i = 0; i < 12; i++){Sprites::drawOverwrite(i*8, 56, sprptn_block, 0);}
}

void drawTitle(){
  arduboy.fillRect(0, 0, 128, 64, BLACK);
  //arduboy.setCursor(0,0);
  //arduboy.print("ALICE CATCHES CARDS");
  Sprites::drawOverwrite(0,0,sprptn_title,0);
  arduboy.setCursor(0,40);
  arduboy.print("Press[A]-1 Turn");
  arduboy.setCursor(0,48);
  arduboy.print("Press[A]-2 CatchCard");
  arduboy.setCursor(0,56);
  arduboy.print("Press[B]   Dash");
  arduboy.display();
  while(arduboy.notPressed(A_BUTTON) &&
      arduboy.notPressed(A_BUTTON)){delay(50);}
}

void setup() {
  arduboy.begin();
  arduboy.setFrameRate(30);
  arduboy.initRandomSeed();
  
  drawTitle();
  
  gl_game.score = 0;
  gl_game.life = 3;
  
  initGame();
}

void loop() {
  if (!(arduboy.nextFrame()))
    return;

  // card
  if(arduboy.everyXFrames(4)){move_card();}
  
  // player
  senceButtonA();
  if(arduboy.everyXFrames(2)){
    if(arduboy.everyXFrames(8) ||arduboy.pressed(B_BUTTON)){
      move_player();
    }
  }
  
  int plframe;
  if(gl_player.wait){plframe = 4;}
  else{plframe = 2 * gl_player.dir + ((gl_player.x >> 1) & 1);}
  
  // drawing GameScene
  arduboy.fillRect(0, 0, 96, 64, WHITE);
  drawBack();
  // Cards
  for(int i = 0; i < 8; i++){
    if( gl_card[i].kind ){
      Sprites::drawExternalMask(i*10 + 8, gl_card[i].y,
        sprptn_card, sprptn_cardmask, gl_card[i].kind, 0);
    }
  }
  // Player
  Sprites::drawExternalMask(gl_player.x, 48,
    sprptn_alice, sprptn_alicemask, plframe, plframe);
  drawTurn();
  
  switch(gl_game.status){
  case 1: // Miss?
    drawMiss();
    break;
  case 2: // effect
    Sprites::drawExternalMask(gl_effect.x, gl_effect.y,
      sprptn_face, sprptn_facemask, gl_effect.rslt, 0);
    arduboy.display();
    delay(500);
    gl_game.status = gl_effect.rslt ? 1:0;
    break;
  
  }
  arduboy.display();
}
